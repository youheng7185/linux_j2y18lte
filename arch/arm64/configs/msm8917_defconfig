## arch/arm64/configs/msm8917_defconfig
```kconfig
#
# Trimmed MSM8917 (Samsung J2 2018) bring-up config
# Use: cp msm8917_defconfig .config && make ARCH=arm64 olddefconfig
#

# ---- General ----
CONFIG_LOCALVERSION="-msm8917"
CONFIG_NO_HZ_IDLE=y
CONFIG_HIGH_RES_TIMERS=y
CONFIG_PREEMPT=y
CONFIG_IKCONFIG=y
CONFIG_IKCONFIG_PROC=y
CONFIG_BLK_DEV_INITRD=y
CONFIG_PROFILING=y
CONFIG_MODULES=y
CONFIG_MODULE_UNLOAD=y
# CONFIG_COMPAT_BRK is not set
CONFIG_CMA=y
CONFIG_DMA_CMA=y
CONFIG_PRINTK_TIME=y
CONFIG_DEBUG_FS=y
CONFIG_MAGIC_SYSRQ=y

# ---- Arch / CPU ----
CONFIG_ARCH_QCOM=y
CONFIG_ARM64_VA_BITS_48=y
CONFIG_NR_CPUS=8
CONFIG_HOTPLUG_CPU=y
CONFIG_HZ_300=y
CONFIG_COMPAT=y
# CONFIG_EFI is not set
CONFIG_PM=y
CONFIG_CPU_IDLE=y
CONFIG_ARM_PSCI_CPUIDLE=y
CONFIG_CPU_FREQ=y
CONFIG_CPU_FREQ_GOV_POWERSAVE=y
CONFIG_CPU_FREQ_GOV_USERSPACE=y
CONFIG_CPUFREQ_DT=y
CONFIG_ARM_QCOM_CPUFREQ_NVMEM=y

# ---- Devtmpfs / fs ----
CONFIG_DEVTMPFS=y
CONFIG_DEVTMPFS_MOUNT=y
CONFIG_BLK_DEV_LOOP=y
CONFIG_EXT4_FS=y
CONFIG_VFAT_FS=y
CONFIG_TMPFS_POSIX_ACL=y
CONFIG_CONFIGFS_FS=y
CONFIG_PSTORE=y
CONFIG_PSTORE_CONSOLE=y
CONFIG_PSTORE_RAM=y
CONFIG_NLS_CODEPAGE_437=y
CONFIG_NLS_ISO8859_1=y

# ---- Block / MMC (eMMC) ----
CONFIG_MMC=y
CONFIG_MMC_BLOCK_MINORS=32
CONFIG_MMC_SDHCI=y
CONFIG_MMC_SDHCI_PLTFM=y
CONFIG_MMC_SDHCI_MSM=y

# ---- Clocks / pinctrl (MSM8917 specific, must exist in your tree) ----
CONFIG_COMMON_CLK_QCOM=y
CONFIG_MSM_GCC_8917=y
CONFIG_QCOM_CLK_SMD_RPM=y
CONFIG_QCOM_CLK_APCS_MSM8916=y
CONFIG_QCOM_A53PLL=y
CONFIG_PINCTRL_MSM=y
CONFIG_PINCTRL_MSM8917=y
CONFIG_PINCTRL_QCOM_SPMI_PMIC=y

# ---- RPM / SMD / SMEM / power domains ----
CONFIG_HWSPINLOCK=y
CONFIG_HWSPINLOCK_QCOM=y
CONFIG_MAILBOX=y
CONFIG_QCOM_APCS_IPC=y
CONFIG_QCOM_SMEM=y
CONFIG_QCOM_SMD_RPM=y
CONFIG_QCOM_SMP2P=y
CONFIG_QCOM_SMSM=y
CONFIG_RPMSG_QCOM_SMD=y
CONFIG_QCOM_RPMPD=y
CONFIG_QCOM_CPR=y
CONFIG_QCOM_SOCINFO=y
CONFIG_QCOM_MPM=y
CONFIG_QCOM_STATS=y
CONFIG_QCOM_RMTFS_MEM=y
CONFIG_REMOTEPROC=y
CONFIG_QCOM_SYSMON=y
CONFIG_NVMEM_QCOM_QFPROM=y
CONFIG_QCOM_BAM_DMA=y
CONFIG_DMADEVICES=y

# ---- PMIC / regulators ----
CONFIG_SPMI=y
CONFIG_MFD_SPMI_PMIC=y
CONFIG_REGULATOR=y
CONFIG_REGULATOR_FIXED_VOLTAGE=y
CONFIG_REGULATOR_QCOM_SMD_RPM=y
CONFIG_REGULATOR_QCOM_SPMI=y
CONFIG_POWER_RESET_MSM=y
CONFIG_POWER_RESET_QCOM_PON=y
CONFIG_RTC_CLASS=y
CONFIG_RTC_DRV_PM8XXX=y
CONFIG_QCOM_SPMI_VADC=y
CONFIG_IIO=y
CONFIG_QCOM_TSENS=y
CONFIG_THERMAL=y
CONFIG_QCOM_SPMI_TEMP_ALARM=y

# ---- Console / watchdog ----
CONFIG_SERIAL_MSM=y
CONFIG_SERIAL_MSM_CONSOLE=y
CONFIG_WATCHDOG=y
CONFIG_WATCHDOG_SYSFS=y
CONFIG_QCOM_WDT=y

# ---- Buses ----
CONFIG_I2C_GPIO=y
CONFIG_I2C_QUP=y
CONFIG_SPI=y
CONFIG_SPI_QUP=y

# ---- Input ----
CONFIG_INPUT_EVDEV=y
CONFIG_KEYBOARD_GPIO=y
CONFIG_INPUT_TOUCHSCREEN=y
CONFIG_TOUCHSCREEN_IMAGIS=y
CONFIG_INPUT_MISC=y
CONFIG_INPUT_PM8941_PWRKEY=y
CONFIG_INPUT_REGULATOR_HAPTIC=y
# CONFIG_SERIO is not set
# CONFIG_KEYBOARD_ATKBD is not set
# CONFIG_MOUSE_PS2 is not set

# ---- Sensors ----
CONFIG_STK3310=y
CONFIG_IIO_ST_ACCEL_3AXIS=y

# ---- LEDs ----
CONFIG_NEW_LEDS=y
CONFIG_LEDS_CLASS=y
CONFIG_LEDS_GPIO=y

# ---- Display: simple framebuffer set up by bootloader ----
CONFIG_DRM=y
CONFIG_DRM_SIMPLEDRM=y
# CONFIG_DRM_MSM is not set
# CONFIG_DRM_PANEL_SAMSUNG_EA8061S_AMS498QV01 is not set
CONFIG_FB=y
CONFIG_FRAMEBUFFER_CONSOLE=y
CONFIG_LOGO=y

# ---- USB gadget (peripheral mode) ----
CONFIG_USB=y
CONFIG_USB_GADGET=y
CONFIG_USB_CHIPIDEA=y
CONFIG_USB_CHIPIDEA_UDC=y
CONFIG_PHY_QCOM_USB_HS=y
CONFIG_EXTCON=y
CONFIG_EXTCON_USB_GPIO=y
CONFIG_USB_CONFIGFS=y
CONFIG_USB_CONFIGFS_RNDIS=y
CONFIG_USB_CONFIGFS_ACM=y

# ---- Out-of-tree / device-specific (dropped silently if absent) ----
CONFIG_MFD_SM5703=y
CONFIG_REGULATOR_SM5703=y
```
